/**
  ******************************************************************************
  * @file    /user_define.c 
  * @author  MMY
  * @version V2.0.0
  * @date    27-June-2015
  * @brief   global variable 
	*
@verbatim  

               
@endverbatim        
  *
  ******************************************************************************
  * @attention
  *
  * COPYRIGHT 2015 CQT Quartz. Co., Ltd.
  *
  ******************************************************************************
  */
	
#include "_common.h"


//THUMB指令不支持汇编内联
//采用如下方法实现执行汇编指令WFI  
__asm void WFI_SET(void)
{
	WFI;		  
}
//关闭所有中断(但是不包括fault和NMI中断)
__asm void INTX_DISABLE(void)
{
	CPSID   I
	BX      LR	  
}
//开启所有中断
__asm void INTX_ENABLE(void)
{
	CPSIE   I
	BX      LR  
}
//设置栈顶地址
//addr:栈顶地址
__asm void MSR_MSP(u32 addr) 
{
	MSR MSP, r0 			//set Main Stack value
	BX r14
}
/**
  * @brief  重启
  * @param  
  * @retval 
  * @note   
  */
void ResetSys(void){
	CLI();
	NVIC_SystemReset();
}

/** @brief  
  * @param  
  * @retval 
  * @note   在PVD的配合下使用
  */
void Restart(void) {
//	__disable_irq();   // 关闭总中断
	
		//RCC_AHB1PeriphResetCmd(0X22E011FF, ENABLE);
		//RCC_APB1PeriphResetCmd(0xE6FEC9FF, ENABLE);
		//RCC_APB2PeriphResetCmd(0x00377F33, ENABLE);
	ResetSys();
}


/** @brief  唯一识别码
  * @param  
  * @retval 
  * @note   
  */
u32 GetOnlyID(void) {
	u32 sn0;
	sn0=*ONLY_ID_ADDR;
	return sn0;
}


/** @brief  
  * @param  
  * @retval 
  * @note   
  */
void NewError(void ) {
	u16 i = 0;
    u8	j = 0;
	u8 sw = 1;
	
	LED3 = LED_ON;
	//Log_Write("NEW ERROR" , LOG_ERROR);
	while(sw)
		if(0 == i++) {
			if(0 ==  j++)
			LED2 = ~LED2;		//呼吸灯;
		}
}
/** @brief  
  * @param  
  * @retval 
  * @note   
  */
void WhileError(void ) {
	u16 i = 0;
  u8	j = 0;
	u8 sw = 1;
	
	LED3 = LED_ON;
	//Log_Write("WHILE ERROR" , LOG_ERROR);
	while(sw)
		if(0 == i++) {
			if(0 ==  j++)
			LED2 = ~LED2;		//呼吸灯;
		}
}

/** @brief  
  * @param  
  * @retval 
  * @note   
  */
void NewMemory(void **p , size_t size ) {

	if(0 == size)
		return;
	
	if(*p!=NULL) { 
#if USE_MEMMNG == 1u
      memmng_free(*p);
#else
      free(*p);
#endif
      //free(*p);
      *p = NULL;
    }
#if USE_MEMMNG == 1u
    *p = (memmng_malloc(size));
#else
    *p = (malloc(size));
#endif
    if(NULL == *p) 
    {
      NewError();
    }
	memset(*p, 0, size);
}
/** @brief  
  * @param  
  * @retval 
  * @note   
  */
void ReNewMemory(void **p , size_t size ) {
	
	if(0 == size)
		return;
	
#if USE_MEMMNG == 1u
  *p = (memmng_realloc(*p ,size));
#else
  *p = (realloc(*p ,size));
#endif

	if(NULL == *p) 
	{
		NewError();
	}
	
}
/** @brief  
  * @param  
  * @retval 
  * @note   
  */
void DelMemory(void **p) {

	if(*p!=NULL) { 
#if USE_MEMMNG == 1u
    memmng_free(*p);
#else
    free(*p);
#endif
    *p = NULL;
  }
	
	
}
		
/** @brief  
  * @param  
  * @retval 
  * @note   
  */
void* MemCpy(void* dst, const void* src, size_t n)  
{  
	char *tmp;  
	char *s_src;  
	size_t s_n;
	
	ASSERT(dst);
	ASSERT(src);
	ASSERT(((u32)dst+n <= (u32)src) || ((u32)src+n <= (u32)dst));
	
memcpy_again:	
	s_n = n;
  tmp = (char*)dst;  
	s_src = (char*)src;  
	while(s_n--) {  
		*tmp++ = *s_src++;  
	}  
	
//使用外扩sram有风险
#if USE_MEMMNG == 1u
	s_n = n;
  tmp = (char*)dst;  
	s_src = (char*)src;  
	while(s_n--) {  
		//ASSERT(*tmp++ == *s_src++);  
		if(*tmp++ != *s_src++)
			goto memcpy_again;
	}  
#endif
	return dst;  
}  
		
/** @brief  
  * @param  
  * @retval 
  * @note   
  */
void* MemCpyUnsafe(void* dst, const void* src, size_t n)  
{  
	char *tmp;  
	char *s_src;  
	size_t s_n;
	
	ASSERT(dst);
	ASSERT(src);
	
	s_n = n;
  tmp = (char*)dst;  
	s_src = (char*)src;  
	while(s_n--) {  
		*tmp++ = *s_src++;  
	}  
	
	return dst;  
}  

/** @brief  
  * @param  
  * @retval 
  * @note   
  */
void* MemMove(void* dst, const void* src, size_t n)  
{  
	char* s_dst;  
	char* s_src;  
	size_t s_n = n;
	ASSERT(dst);
	ASSERT(src);
	s_dst = (char*)dst;  
	s_src = (char*)src;  
	if(s_dst>s_src && (s_src+n>s_dst)) { 
		s_dst = s_dst+n-1;  
		s_src = s_src+n-1;  
		while(n--) {  
			*s_dst-- = *s_src--;  
		}  
	} else {  
		while(n--) {  
			*s_dst++ = *s_src++;  
		}  
	}  
	return dst;  
}  


void DelayUS(u32 cnt)
{
	u32 j;
	cnt=cnt*18;//cnt=cnt*42;
	for(j=0;j<cnt;j++);
}

	
/** @brief  
  * @param  
  * @retval 
  * @note   
  */
void assert(uint8_t* file, uint8_t* function, uint32_t line)
{ 
  char tmp[100]={0};
	char loop = 1;
	
	__disable_irq();   // 关闭总中断
	
	//g_cdvStat = CDV_ASSERT;
	
	sprintf(tmp , "npc assert occur! file:%s\r\nfunction:%s\r\nline:%d\r\n" 
	,file 
	,function
	,line
	);
	
  while (loop)
  {
	//	USARTSend((u8*)tmp, strlen(tmp), MAIN_COM);
		DelayUS(5000000);
  }
	
	__enable_irq();
}
/** @brief  
  * @param  
  * @retval 
  * @note   
  */
void assert_plus(uint8_t* file, uint8_t* function, uint32_t line, char* str, int len)
{ 
	#define NUM_ASSERT 200
  char tmp[NUM_ASSERT]={0};
	char loop = 1;
	
	__disable_irq();   // 关闭总中断
	
	//g_cdvStat = CDV_ASSERT;
	
	sprintf(tmp , "npc assert occur! file:%s\r\nfunction:%s\r\nline:%d\r\n" 
	,file 
	,function
	,line
	);
	
	
	if(len && str)
	  if(strlen(tmp)+len < NUM_ASSERT) {
		  MemCpy(tmp+strlen(tmp),str,len);
			MemCpy(tmp+strlen(tmp)+len,"\r\n",2);
		}
	
  while (loop)
  {
		//USARTSend((u8*)tmp, strlen(tmp), MAIN_COM);
		DelayUS(5000000);
  }
	
	__enable_irq();
}
/** @brief  
  * @param  
  * @retval 
  * @note   主串口如果与触摸屏设备连，则不能开启调试
  */
void com_print(const char* str)
{
		//USARTSend((u8*)str, strlen(str), MAIN_COM);
}
//////////crc 

const unsigned char chCRCHTalbe[] =                                 // CRC 高位字节值表
{
0x00, 0xC1, 0x81, 0x40, 0x01, 0xC0, 0x80, 0x41, 0x01, 0xC0, 0x80, 0x41,
0x00, 0xC1, 0x81, 0x40, 0x01, 0xC0, 0x80, 0x41, 0x00, 0xC1, 0x81, 0x40,
0x00, 0xC1, 0x81, 0x40, 0x01, 0xC0, 0x80, 0x41, 0x01, 0xC0, 0x80, 0x41,
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0x00, 0xC1, 0x81, 0x40
};

const unsigned char chCRCLTalbe[] =                                 // CRC 低位字节值表
{
0x00, 0xC0, 0xC1, 0x01, 0xC3, 0x03, 0x02, 0xC2, 0xC6, 0x06, 0x07, 0xC7,
0x05, 0xC5, 0xC4, 0x04, 0xCC, 0x0C, 0x0D, 0xCD, 0x0F, 0xCF, 0xCE, 0x0E,
0x0A, 0xCA, 0xCB, 0x0B, 0xC9, 0x09, 0x08, 0xC8, 0xD8, 0x18, 0x19, 0xD9,
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0x41, 0x81, 0x80, 0x40
};

// crc = MODBUS_CRC16(buf,len, 0xFFFF);
unsigned short MODBUS_CRC16(unsigned char* pchMsg, unsigned short wDataLen, unsigned short crc)
{
        unsigned char chCRCHi = (crc >> 8) & 0xFF; // 高CRC字节初始化
        unsigned char chCRCLo = crc & 0xFF; // 低CRC字节初始化
        unsigned short wIndex;            // CRC循环中的索引

        while (wDataLen--)
        {
                // 计算CRC
                wIndex = chCRCLo ^ *pchMsg++ ;
                chCRCLo = chCRCHi ^ chCRCHTalbe[wIndex];
                chCRCHi = chCRCLTalbe[wIndex] ;
        }

        return ((chCRCHi << 8) | chCRCLo) ;
}
   
/////////////////////////////////////ticks

volatile uint32_t sys_ticks;                       /* timeTicks counter */
void SysTick_Handler(void) {
  sys_ticks++;                                     /* increment timeTicks counter */
}

//__INLINE static void Delay (uint32_t dlyTicks) {
//  uint32_t curTicks = msTicks;
//  while ((msTicks - curTicks) < dlyTicks);
//}

//#define COUNT_TICK // 1个tick 是 1ms
u32 CalcCount(u32 end_count , u32 start_count) {
	u32 count = end_count >= start_count ? end_count - start_count : ((u32)0xFFFFFFFF) - start_count + end_count; 
	return (count);
}